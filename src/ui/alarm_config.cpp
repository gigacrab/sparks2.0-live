#include "ui.h"
#include <TFT_eSPI.h>
#include <gfxfont.h>
#include "fonts/Petme8x8.h"
static const unsigned char PROGMEM image_Down_bits[] = {0x1f,0xff,0xfc,0x00,0x20,0x00,0x02,0x00,0x40,0x00,0x01,0x00,0x80,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0xfc,0x00};
static const unsigned char PROGMEM image_Up_bits[] = {0x1f,0xff,0xfc,0x00,0x20,0x00,0x02,0x00,0x40,0x00,0x01,0x00,0x80,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0xfc,0x00};
static const unsigned char PROGMEM image_Vol_down_bits[] = {0x1f,0xff,0xfc,0x00,0x20,0x00,0x02,0x00,0x40,0x00,0x01,0x00,0x80,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0xfc,0x00};
static const unsigned char PROGMEM image_Vol_up_bits[] = {0x1f,0xff,0xfc,0x00,0x20,0x00,0x02,0x00,0x40,0x00,0x01,0x00,0x80,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0xfc,0x00};


void drawAlarmConfig(void) {
    tft.fillScreen(0x0);
    // back_btn
    tft.setTextColor(0x651D);
    tft.setTextSize(1);
    tft.setFreeFont(&Petme8x8);
    tft.drawString("<Back", 10, 10);
    // hour_input
    tft.setTextColor(0xFF8D);
    tft.setFreeFont(&FreeMono24pt7b);
    tft.drawString("00", 90, 61);
    // minute_input
    tft.drawString("00", 174, 61);
    // comma_disp
    tft.setTextColor(0xFFFF);
    tft.drawString(":", 146, 61);
    // month_input
    tft.setTextColor(0xFF8D);
    tft.setFreeFont(&FreeSerif9pt7b);
    tft.drawString("Feb", 107, 107);
    // day_input
    tft.drawString("00,", 144, 107);
    // year_input
    tft.drawString("2026", 176, 107);
    // hour_highlight
    tft.drawRect(93, 101, 50, 2, 0xFFFF);
    // minute_highlight
    tft.drawRect(177, 101, 50, 2, 0xFFFF);
    // month_highlight
    tft.drawRect(106, 127, 30, 2, 0xFFFF);
    // year_highlight
    tft.drawRect(174, 127, 40, 2, 0xFFFF);
    // day_highlight
    tft.drawRect(143, 127, 20, 2, 0xFFFF);
    // Vol_down
    tft.drawBitmap(177, 162, image_Vol_down_bits, 25, 27, 0x651D);
    // Vol_up
    tft.drawBitmap(212, 162, image_Vol_up_bits, 25, 27, 0x651D);
    // Up
    tft.drawBitmap(115, 162, image_Up_bits, 25, 27, 0x651D);
    // Down
    tft.drawBitmap(81, 162, image_Down_bits, 25, 27, 0x651D);
    // Layer 20
    tft.setTextColor(0x651D);
    tft.setFreeFont(&Petme8x8);
    tft.drawString("Confirm", 132, 221);
}

void handleAlarmConfigInput(int x, int y) {
    if (inRange(x, 10 - 10, 50 + 10) && inRange(y, 10 - 10, 19 + 10)) { // pressed back
    
    } else if (inRange(x, 120 - 10, 200 + 10) && inRange(y, 221 - 10, 230 + 10)) { // pressed confirm
    
    } else if (inRange(x, 212, 237) && inRange(y, 162, 189)) { // pressed increment
    
    } else if (inRange(x, 177, 202) && inRange(y, 162, 189)) { // pressed decrement
    
    } else if (inRange(x, 81, 106) && inRange(y, 162, 189)) { // pressed previous
    
    } else if (inRange(x, 116, 141)  && inRange(y, 162, 189)) { // pressed next
    
    }
}
